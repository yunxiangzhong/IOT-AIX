## AIX/Kconfig.projbuild
```kconfig
menu "AIX pulse helmet configuration"

config AIX_ENABLE_LOCAL_CAMERA
    bool "Enable local OV5640 camera capture"
    default y
    help
        Start fixed-wiring OV5640 capture. It validates QVGA JPEG frames and
        emits camera_status; future visual models run on the ESP32-S3.

config AIX_CAMERA_CAPTURE_PERIOD_MS
    int "Local camera capture period (ms)"
    default 200
    range 100 1000
    depends on AIX_ENABLE_LOCAL_CAMERA

endmenu
```

## AIX/main/Kconfig.projbuild
```kconfig
menu "AIX pulse helmet configuration"

config AIX_ENABLE_LOCAL_CAMERA
    bool "Enable local OV5640 camera capture"
    default y
    help
        Start fixed-wiring OV5640 capture. It validates QVGA JPEG frames and
        emits camera_status; future visual models run on the ESP32-S3.

config AIX_CAMERA_CAPTURE_PERIOD_MS
    int "Local camera capture period (ms)"
    default 200
    range 100 1000
    depends on AIX_ENABLE_LOCAL_CAMERA

config AIX_ENABLE_CAMERA_PREVIEW
    bool "Enable Wi-Fi JPEG preview for the host application"
    default n
    depends on AIX_ENABLE_LOCAL_CAMERA
    help
        Join the configured 2.4 GHz Wi-Fi network and serve the latest OV5640
        JPEG at /capture.jpg. The preview URL is emitted over serial.

config AIX_CAMERA_PREVIEW_PORT
    int "Camera preview HTTP port"
    default 8081
    range 1024 65535
    depends on AIX_ENABLE_CAMERA_PREVIEW

config AIX_ENABLE_VISION_UPLINK
    bool "Enable Wi-Fi upload to the PC Depth Anything 3 service"
    default y
    depends on AIX_ENABLE_LOCAL_CAMERA

config AIX_ENABLE_RISK_RECEIVER
    bool "Enable PC vision risk callback receiver"
    default y

config AIX_ENABLE_PNEUMATIC_CONTROL
    bool "Enable pump and solenoid-valve control hardware"
    default n
    help
        Configure GPIO40 (pump MOSFET) and GPIO41 (valve MOSFET). Both outputs
        start low, which stops the pump and vents through the specified 3-port
        valve routing. This option is intentionally disabled by default.

config AIX_ENABLE_PNEUMATIC_AUTOMATIC
    bool "Enable automatic pneumatic response after saved calibration"
    default n
    depends on AIX_ENABLE_PNEUMATIC_CONTROL
    help
        This firmware-build option is the only way to enable automatic response
        to PC visual HIGH/CRITICAL or MPU impact/rapid-tilt events. The host UI
        cannot enable it. A valid calibration must also be saved in NVS.

config AIX_ENABLE_ONBOARD_RGB
    bool "Enable DevKitC-1 onboard RGB action indicator on GPIO38"
    default y

config AIX_WIFI_SSID
    string "Wi-Fi SSID"
    default ""
    depends on AIX_ENABLE_CAMERA_PREVIEW || AIX_ENABLE_VISION_UPLINK || AIX_ENABLE_RISK_RECEIVER

config AIX_WIFI_PASSWORD
    string "Wi-Fi password"
    default ""
    depends on AIX_ENABLE_CAMERA_PREVIEW || AIX_ENABLE_VISION_UPLINK || AIX_ENABLE_RISK_RECEIVER

config AIX_DEVICE_ID
    string "AIX device identifier"
    default "aix-helmet-01"

config AIX_LINK_TOKEN
    string "PC/ESP link token"
    default ""

config AIX_RISK_RECEIVER_PORT
    int "Vision risk callback port"
    default 8080
    range 1024 65535
    depends on AIX_ENABLE_RISK_RECEIVER

config AIX_VISION_SERVICE_URL
    string "PC Depth Anything 3 service URL"
    default "http://192.168.137.1:8008/v1/frames"
    depends on AIX_ENABLE_VISION_UPLINK

config AIX_VISION_UPLOAD_PERIOD_MS
    int "Vision JPEG upload period (ms)"
    default 400
    range 200 10000
    depends on AIX_ENABLE_VISION_UPLINK

config AIX_VISION_HTTP_TIMEOUT_MS
    int "Vision HTTP timeout (ms)"
    default 1500
    range 500 10000
    depends on AIX_ENABLE_VISION_UPLINK

endmenu
```

## AIX/sdkconfig.defaults
```kconfig
CONFIG_IDF_TARGET="esp32s3"
CONFIG_PARTITION_TABLE_CUSTOM=y
CONFIG_PARTITION_TABLE_CUSTOM_FILENAME="partitions.csv"
CONFIG_AIX_ENABLE_LOCAL_CAMERA=y
CONFIG_AIX_ENABLE_CAMERA_PREVIEW=n
CONFIG_AIX_ENABLE_VISION_UPLINK=y
CONFIG_AIX_ENABLE_RISK_RECEIVER=y
CONFIG_AIX_ENABLE_VOICE_PROMPT=y
CONFIG_AIX_VOICE_VOLUME=18
CONFIG_AIX_ENABLE_PNEUMATIC_CONTROL=n
CONFIG_AIX_ENABLE_PNEUMATIC_AUTOMATIC=n
CONFIG_AIX_ENABLE_ONBOARD_RGB=y
CONFIG_AIX_DEVICE_ID="aix-helmet-01"
CONFIG_AIX_VISION_SERVICE_URL="http://192.168.137.1:8008/v1/frames"
CONFIG_AIX_VISION_UPLOAD_PERIOD_MS=400
CONFIG_AIX_VISION_HTTP_TIMEOUT_MS=1500
```
